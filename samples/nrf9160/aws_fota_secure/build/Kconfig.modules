## samples/nrf9160/aws_fota_secure/build/Kconfig.modules
```kconfig
osource "/Users/aaarcr/ncs/nrf/Kconfig.nrf"

osource "/Users/aaarcr/ncs/bootloader/mcuboot/zephyr/Kconfig"

osource "/Users/aaarcr/ncs/nrfxlib/Kconfig.nrfxlib"
```
